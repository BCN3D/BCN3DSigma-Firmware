// File generated 02/08/2018 14:33:23
// Warning! This is a generated file, any manual changes will be
// lost during the next generation.

#constant  Strings3Count    0
#constant  Strings3Size     1
#constant  Strings1Count    0
#constant  Strings1Size     1
#constant  Strings8Count    0
#constant  Strings8Size     1
#constant  Strings12Count    0
#constant  Strings12Size     1
#constant  Strings23Count    0
#constant  Strings23Size     1
#constant  Strings16Count    0
#constant  Strings16Size     1
#constant  Strings2Count    0
#constant  Strings2Size     1
#constant  Strings7Count    0
#constant  Strings7Size     1
#constant  Strings9Count    0
#constant  Strings9Size     1
#constant  Strings10Count    0
#constant  Strings10Size     1
#constant  Strings27Count    0
#constant  Strings27Size     1
#constant  Strings48Count    0
#constant  Strings48Size     1
#constant  Strings13Count    0
#constant  Strings13Size     1
#constant  Strings38Count    0
#constant  Strings38Size     1
#constant  Strings53Count    0
#constant  Strings53Size     1
#constant  Strings11Count    1
#constant  Strings11Size     7
#constant  Strings39Count    0
#constant  Strings39Size     1
#constant  Strings44Count    0
#constant  Strings44Size     1
#constant  Strings49Count    1
#constant  Strings49Size     12
#constant  Strings52Count    0
#constant  Strings52Size     1
#constant  Strings50Count    0
#constant  Strings50Size     1
#constant  Strings55Count    0
#constant  Strings55Size     1
#constant  Strings5Count    0
#constant  Strings5Size     1
#constant  Strings6Count    0
#constant  Strings6Size     1
#constant  Strings0Count    0
#constant  Strings0Size     1
#constant  Strings4Count    1
#constant  Strings4Size     12
#constant  Strings14Count    0
#constant  Strings14Size     1
// object indexes into ImageControl
#CONST
    iVideo0         // offset 0x0
    iForm1          // offset 0x56CC00
    iUserbutton1    // offset 0x5B7E00
    iUserbutton61   // offset 0x5CB800
    iUserbutton88   // offset 0x5DF200
    iForm2          // offset 0x5F2A00
    iUserbutton5    // offset 0x63DC00
    iUserbutton15   // offset 0x641400
    iUserbutton37   // offset 0x669200
    iUserbutton55   // offset 0x66CA00
    iUserbutton14   // offset 0x675C00
    iUserbutton56   // offset 0x69E800
    iUserbutton85   // offset 0x6C5A00
    iUserbutton86   // offset 0x6EE600
    iUserimages1    // offset 0x715800
    iVideo14        // offset 0x721A00
    i4Dbutton39     // offset 0x7FCA00
    iUserimages19   // offset 0x801400
    iUserimages20   // offset 0x81EA00
    iUserimages21   // offset 0x83C000
    iUserimages22   // offset 0x859600
    iUserimages23   // offset 0x876C00
    iUserimages30   // offset 0x894200
    iUserimages26   // offset 0x895400
    iUserimages27   // offset 0x896600
    iUserimages28   // offset 0x897800
    iUserimages29   // offset 0x898A00
    iUserimages31   // offset 0x899C00
    iUserimages32   // offset 0x89AE00
    iUserimages33   // offset 0x89C000
    iUserimages34   // offset 0x89D200
    iUserimages35   // offset 0x89E400
    iUserimages36   // offset 0x89F600
    iUserimages37   // offset 0x8A0800
    iUserimages38   // offset 0x8A1A00
    iUserimages39   // offset 0x8A2C00
    iUserimages40   // offset 0x8A3E00
    iUserimages41   // offset 0x8A5000
    iUserimages42   // offset 0x8A6200
    iUserimages43   // offset 0x8A7400
    iUserimages52   // offset 0x8A8600
    iUserimages44   // offset 0x8A9800
    iUserimages45   // offset 0x8AAA00
    iUserimages46   // offset 0x8ABC00
    iUserimages53   // offset 0x8ACE00
    iUserimages47   // offset 0x8AE000
    iUserimages48   // offset 0x8AF200
    iUserimages49   // offset 0x8B0400
    iUserimages58   // offset 0x8B1600
    iUserimages50   // offset 0x8B2800
    iUserimages51   // offset 0x8B3A00
    iUserimages54   // offset 0x8B4C00
    iUserimages55   // offset 0x8B5E00
    iUserimages56   // offset 0x8B7000
    iUserimages57   // offset 0x8B8200
    iUserimages59   // offset 0x8B9400
    iUserimages60   // offset 0x8BA600
    iUserimages61   // offset 0x8BB800
    iUserimages62   // offset 0x8BCA00
    iUserimages63   // offset 0x8BDC00
    iUserimages64   // offset 0x8BEE00
    iUserimages65   // offset 0x8C0000
    iUserimages66   // offset 0x8C1200
    iUserimages67   // offset 0x8C2400
    iUserimages68   // offset 0x8C3600
    iUserimages69   // offset 0x8C4800
    iUserimages70   // offset 0x8C5A00
    iForm4          // offset 0x8C6C00
    iUserbutton8    // offset 0x911E00
    iUserbutton7    // offset 0x92F800
    iUserbutton9    // offset 0x94D000
    iUserbutton224  // offset 0x96A800
    i4Dbutton45     // offset 0x988200
    iForm5          // offset 0x98CC00
    iUserbutton12   // offset 0x9D7E00
    iUserbutton13   // offset 0xA00000
    iUserbutton54   // offset 0xA28200
    iUserbutton57   // offset 0xA50400
    iForm6          // offset 0xA54E00
    iUserbutton2    // offset 0xAA0000
    iUserbutton50   // offset 0xAC7E00
    iUserbutton159  // offset 0xAEF600
    i4Dbutton48     // offset 0xB17400
    i4Dbutton71     // offset 0xB1BE00
    iForm9          // offset 0xB20800
    iUserbutton19   // offset 0xB6BA00
    iUserbutton16   // offset 0xB90600
    iUserbutton18   // offset 0xBB5200
    iCustomdigits6  // offset 0xBD9E00
    iiCustomdigits6 // offset 0xBDA600
    iCustomdigits7  // offset 0xBDC000
    iiCustomdigits7 // offset 0xBDC800
    iCustomdigits8  // offset 0xBDE200
    iiCustomdigits8 // offset 0xBDEA00
    iCustomdigits11 // offset 0xBE0400
    iiCustomdigits11 // offset 0xBE0C00
    iCustomdigits12 // offset 0xBE2600
    iiCustomdigits12 // offset 0xBE2E00
    iCustomdigits13 // offset 0xBE4800
    iiCustomdigits13 // offset 0xBE4E00
    iCustomdigits14 // offset 0xBE6800
    iiCustomdigits14 // offset 0xBE7200
    iUserbutton126  // offset 0xBE8C00
    iUserimages6    // offset 0xBF1E00
    iForm14         // offset 0xBFB400
    iUserbutton17   // offset 0xC46600
    iUserbutton32   // offset 0xC64000
    iUserbutton33   // offset 0xC81800
    iForm19         // offset 0xC9F200
    i4Dbutton77     // offset 0xCEA400
    iForm20         // offset 0xD07E00
    iUserbutton75   // offset 0xD53000
    iUserbutton76   // offset 0xD8EA00
    iUserbutton77   // offset 0xDCA000
    iUserbutton83   // offset 0xDD3200
    iUserbutton65   // offset 0xDDC400
    iUserbutton70   // offset 0xDF4600
    iUserimages13   // offset 0xE0C800
    iUserimages14   // offset 0xE24A00
    iUserimages15   // offset 0xE3CC00
    iUserbutton78   // offset 0xE54E00
    iUserbutton79   // offset 0xE6D000
    iUserbutton215  // offset 0xE85200
    iForm21         // offset 0xE9D400
    iUserbutton53   // offset 0xEE8600
    iVideo11        // offset 0xF23600
    iForm28         // offset 0x1095C00
    iUserbutton11   // offset 0x10E0E00
    iUserbutton81   // offset 0x10FF800
    iUserbutton82   // offset 0x111DC00
    iVideo3         // offset 0x113C600
    iVideo4         // offset 0x122F400
    iVideo5         // offset 0x131CC00
    iCustomdigits24 // offset 0x140CC00
    iiCustomdigits24 // offset 0x140D400
    iCustomdigits25 // offset 0x140EE00
    iiCustomdigits25 // offset 0x140F600
    iCustomdigits26 // offset 0x1411000
    iiCustomdigits26 // offset 0x1411800
    iCustomdigits27 // offset 0x1413200
    iiCustomdigits27 // offset 0x1413A00
    iCustomdigits28 // offset 0x1415400
    iiCustomdigits28 // offset 0x1415C00
    iCustomdigits29 // offset 0x1417600
    iiCustomdigits29 // offset 0x1417E00
    i4Dbutton42     // offset 0x1419800
    iForm31         // offset 0x141E200
    iUserbutton94   // offset 0x1469400
    iUserimages4    // offset 0x1486C00
    iForm32         // offset 0x14E9600
    iUserbutton95   // offset 0x1534800
    iUserimages5    // offset 0x1552000
    iForm33         // offset 0x15B4A00
    iUserbutton26   // offset 0x15FFC00
    iUserbutton22   // offset 0x160EC00
    iUserbutton23   // offset 0x161A800
    iUserbutton24   // offset 0x1626400
    iUserbutton25   // offset 0x1632000
    iUserbutton27   // offset 0x163DC00
    iUserbutton34   // offset 0x1649A00
    iUserbutton35   // offset 0x1655600
    iUserbutton129  // offset 0x1661200
    iUserbutton135  // offset 0x166CE00
    iUserbutton136  // offset 0x1678A00
    iUserbutton138  // offset 0x1684800
    iUserimages11   // offset 0x16A2000
    iUserimages16   // offset 0x16C0200
    iForm34         // offset 0x16DDC00
    iUserbutton112  // offset 0x1728E00
    iUserbutton113  // offset 0x1730400
    iUserbutton114  // offset 0x1737A00
    iUserbutton212  // offset 0x174CA00
    iVideo16        // offset 0x1751400
    iForm35         // offset 0x17FF600
    iUserbutton115  // offset 0x184A800
    iUserbutton116  // offset 0x185F800
    iUserbutton117  // offset 0x1866E00
    iUserbutton213  // offset 0x186E400
    iVideo17        // offset 0x1872E00
    iForm16         // offset 0x1921000
    iUserbutton41   // offset 0x196C200
    iUserbutton158  // offset 0x197AE00
    iVideo10        // offset 0x1989A00
    iForm44         // offset 0x1B17200
    iUserbutton151  // offset 0x1B62400
    iUserbutton152  // offset 0x1B71400
    iUserbutton154  // offset 0x1B80400
    iUserbutton155  // offset 0x1BAD600
    iUserbutton156  // offset 0x1BDA200
    iUserbutton157  // offset 0x1BE9200
    iVideo20        // offset 0x1BF8200
    iCustomdigits38 // offset 0x1C1FE00
    iiCustomdigits38 // offset 0x1C20600
    iCustomdigits39 // offset 0x1C22000
    iiCustomdigits39 // offset 0x1C22800
    iCustomdigits40 // offset 0x1C24200
    iiCustomdigits40 // offset 0x1C24A00
    i4Dbutton60     // offset 0x1C26400
    iUserbutton74   // offset 0x1C2AE00
    iForm3          // offset 0x1C34000
    iUserbutton29   // offset 0x1C7F200
    i4Dbutton0      // offset 0x1C9CC00
    i4Dbutton1      // offset 0x1CA2A00
    i4Dbutton13     // offset 0x1CA8800
    iForm13         // offset 0x1CAD200
    iUserbutton30   // offset 0x1CF8400
    i4Dbutton2      // offset 0x1D15E00
    i4Dbutton3      // offset 0x1D1BC00
    i4Dbutton11     // offset 0x1D21A00
    iForm47         // offset 0x1D26400
    i4Dbutton83     // offset 0x1D71600
    iForm17         // offset 0x1D8F000
    iVideo6         // offset 0x1DDA200
    iForm25         // offset 0x1F28600
    iUserbutton131  // offset 0x1F73800
    iUserbutton160  // offset 0x1F82800
    iUserbutton162  // offset 0x1FA0000
    iUserbutton177  // offset 0x1FABC00
    iUserbutton178  // offset 0x1FB7800
    iUserbutton197  // offset 0x1FC3400
    iUserbutton204  // offset 0x1FCF000
    iUserbutton205  // offset 0x1FDAE00
    iUserimages12   // offset 0x1FDF800
    iForm49         // offset 0x2000600
    iUserbutton130  // offset 0x204B800
    iUserbutton64   // offset 0x205A400
    i4Dbutton34     // offset 0x2069000
    i4Dbutton72     // offset 0x206EE00
    i4Dbutton16     // offset 0x2074C00
    iForm52         // offset 0x2079600
    iUserbutton144  // offset 0x20C4800
    iUserbutton148  // offset 0x20CE000
    iUserbutton149  // offset 0x20D7800
    iUserbutton150  // offset 0x20F5200
    iUserbutton161  // offset 0x20FE800
    iCustomdigits36 // offset 0x2107E00
    iiCustomdigits36 // offset 0x2108600
    iCustomdigits37 // offset 0x210A000
    iiCustomdigits37 // offset 0x210A800
    i4Dbutton61     // offset 0x210C200
    iForm10         // offset 0x2110C00
    i4Dbutton14     // offset 0x215BE00
    iForm12         // offset 0x2179800
    i4Dbutton76     // offset 0x21C4A00
    iForm15         // offset 0x21E2400
    iUserbutton38   // offset 0x222D600
    iUserbutton39   // offset 0x224AE00
    iCustomdigits56 // offset 0x2268600
    iiCustomdigits56 // offset 0x2268E00
    iCustomdigits57 // offset 0x226A200
    iiCustomdigits57 // offset 0x226A600
    iCustomdigits58 // offset 0x226BA00
    iiCustomdigits58 // offset 0x226C000
    iForm8          // offset 0x226D400
    iVideo1         // offset 0x22B8600
    iForm11         // offset 0x244EE00
    iUserbutton3    // offset 0x249A000
    iUserbutton40   // offset 0x24B0200
    iUserbutton42   // offset 0x24B7C00
    iUserbutton45   // offset 0x24BF400
    iUserbutton46   // offset 0x24C6C00
    iVideo15        // offset 0x24CE600
    i4Dbutton36     // offset 0x2692000
    iForm18         // offset 0x2696A00
    iUserbutton59   // offset 0x26E1C00
    iUserbutton80   // offset 0x2709A00
    iUserbutton216  // offset 0x2731200
    i4Dbutton37     // offset 0x2758800
    i4Dbutton38     // offset 0x275D200
    iForm36         // offset 0x2761C00
    iVideo2         // offset 0x27ACE00
    iCustomdigits32 // offset 0x2943600
    iiCustomdigits32 // offset 0x2943E00
    iForm29         // offset 0x2945800
    iUserbutton91   // offset 0x2990A00
    iUserbutton92   // offset 0x29CB000
    iUserbutton121  // offset 0x2A05A00
    iUserbutton122  // offset 0x2A23200
    iUserimages0    // offset 0x2A40A00
    i4Dbutton43     // offset 0x2A5EC00
    i4Dbutton58     // offset 0x2A63600
    iForm22         // offset 0x2A68000
    iUserbutton90   // offset 0x2AB3200
    iUserbutton123  // offset 0x2AEEC00
    i4Dbutton57     // offset 0x2B2A200
    iUserbutton84   // offset 0x2B2EC00
    iForm37         // offset 0x2B37E00
    i4Dbutton80     // offset 0x2B83000
    iForm38         // offset 0x2BA0A00
    iUserbutton133  // offset 0x2BEBC00
    iForm39         // offset 0x2C09600
    iUserbutton140  // offset 0x2C54800
    iUserbutton141  // offset 0x2C7C000
    iUserbutton153  // offset 0x2CA3800
    i4Dbutton44     // offset 0x2CCB000
    i4Dbutton59     // offset 0x2CCFA00
    iForm23         // offset 0x2CD4400
    iUserbutton66   // offset 0x2D1F600
    iUserbutton217  // offset 0x2D2E200
    iForm42         // offset 0x2D3CE00
    iUserbutton87   // offset 0x2D88000
    iUserbutton118  // offset 0x2DACC00
    iUserbutton137  // offset 0x2DD1800
    iUserbutton237  // offset 0x2DDAA00
    iCustomdigits15 // offset 0x2DFF600
    iiCustomdigits15 // offset 0x2E00000
    iCustomdigits16 // offset 0x2E01A00
    iiCustomdigits16 // offset 0x2E02000
    iCustomdigits17 // offset 0x2E03A00
    iiCustomdigits17 // offset 0x2E04200
    iCustomdigits18 // offset 0x2E05C00
    iiCustomdigits18 // offset 0x2E06400
    iCustomdigits20 // offset 0x2E07E00
    iiCustomdigits20 // offset 0x2E08600
    iCustomdigits21 // offset 0x2E0A000
    iiCustomdigits21 // offset 0x2E0A800
    iCustomdigits23 // offset 0x2E0C200
    iiCustomdigits23 // offset 0x2E0CA00
    iUserimages3    // offset 0x2E0E400
    iForm43         // offset 0x2E17A00
    iUserbutton68   // offset 0x2E62C00
    iForm46         // offset 0x2E9DE00
    iVideo9         // offset 0x2EE9000
    i4Dbutton82     // offset 0x3076800
    iForm50         // offset 0x3094200
    iUserbutton179  // offset 0x30DF400
    iUserbutton180  // offset 0x30EE000
    i4Dbutton35     // offset 0x30FCC00
    i4Dbutton73     // offset 0x3102A00
    i4Dbutton15     // offset 0x3108800
    iForm51         // offset 0x310D200
    iUserbutton181  // offset 0x3158400
    iUserbutton182  // offset 0x3167000
    iForm54         // offset 0x3184800
    iUserbutton186  // offset 0x31CFA00
    iUserbutton187  // offset 0x31DE600
    iForm55         // offset 0x31FBE00
    iUserbutton183  // offset 0x3247000
    iUserbutton184  // offset 0x3249400
    iUserbutton185  // offset 0x3258000
    iForm41         // offset 0x3275800
    iUserbutton67   // offset 0x32C0A00
    iUserbutton188  // offset 0x32CF600
    iForm24         // offset 0x32ECE00
    i4Dbutton78     // offset 0x3338000
    iForm56         // offset 0x3355A00
    i4Dbutton91     // offset 0x33A0C00
    iForm57         // offset 0x33BE600
    iUserbutton49   // offset 0x3409800
    iUserbutton190  // offset 0x3427000
    iForm7          // offset 0x3444800
    i4Dbutton86     // offset 0x348FA00
    iForm58         // offset 0x34AD400
    iVideo19        // offset 0x34F8600
    iCustomdigits30 // offset 0x35C8200
    iiCustomdigits30 // offset 0x35C8A00
    iForm60         // offset 0x35CA400
    iUserbutton194  // offset 0x3615600
    iUserbutton195  // offset 0x3624800
    iForm62         // offset 0x3633A00
    iUserbutton191  // offset 0x367EC00
    iUserbutton218  // offset 0x368D800
    iForm63         // offset 0x369C400
    i4Dbutton85     // offset 0x36E7600
    iForm59         // offset 0x3705000
    iUserbutton193  // offset 0x3750200
    iUserbutton196  // offset 0x3754E00
    iUserbutton199  // offset 0x3759A00
    iUserbutton200  // offset 0x3768800
    iUserbutton201  // offset 0x3777A00
    iUserbutton202  // offset 0x3786400
    iUserbutton203  // offset 0x3795600
    iUserimages2    // offset 0x37AC000
    i4Dbutton47     // offset 0x37C0C00
    i4Dbutton63     // offset 0x37C5600
    iForm64         // offset 0x37CA000
    iUserbutton206  // offset 0x3815200
    iUserbutton207  // offset 0x3832A00
    iForm65         // offset 0x3850200
    iUserbutton198  // offset 0x389B400
    iUserbutton209  // offset 0x38C2A00
    iUserbutton134  // offset 0x38E9A00
    i4Dbutton49     // offset 0x390D200
    iForm66         // offset 0x3911C00
    i4Dbutton50     // offset 0x395CE00
    i4Dbutton64     // offset 0x3961800
    iForm67         // offset 0x3966200
    iUserbutton211  // offset 0x39B1400
    iVideo18        // offset 0x39CEE00
    iForm68         // offset 0x3BE7200
    iCustomdigits62 // offset 0x3C32400
    iiCustomdigits62 // offset 0x3C32800
    iCustomdigits63 // offset 0x3C34200
    iiCustomdigits63 // offset 0x3C34600
    iCustomdigits64 // offset 0x3C36000
    iiCustomdigits64 // offset 0x3C36400
    iCustomdigits65 // offset 0x3C37E00
    iiCustomdigits65 // offset 0x3C38200
    i4Dbutton51     // offset 0x3C39C00
    i4Dbutton65     // offset 0x3C3E600
    iUserimages18   // offset 0x3C43000
    iForm26         // offset 0x3C48800
    iUserbutton93   // offset 0x3C93A00
    iUserbutton172  // offset 0x3CB1200
    iCustomdigits59 // offset 0x3CCEA00
    iiCustomdigits59 // offset 0x3CCEE00
    iCustomdigits60 // offset 0x3CD0200
    iiCustomdigits60 // offset 0x3CD0800
    iCustomdigits61 // offset 0x3CD1C00
    iiCustomdigits61 // offset 0x3CD2400
    iForm30         // offset 0x3CD3800
    iUserbutton173  // offset 0x3D1EA00
    iUserbutton174  // offset 0x3D2D600
    iForm45         // offset 0x3D3C200
    iVideo21        // offset 0x3D87400
    iForm69         // offset 0x3EF9A00
    iForm70         // offset 0x3F44C00
    i4Dbutton87     // offset 0x3F8FE00
    iForm71         // offset 0x3FAD800
    i4Dbutton88     // offset 0x3FF8A00
    iForm72         // offset 0x4016400
    iVideo22        // offset 0x4061600
    iForm73         // offset 0x41D3C00
    iVideo23        // offset 0x421EE00
    iForm74         // offset 0x485CE00
    iUserbutton208  // offset 0x48A8000
    iUserbutton214  // offset 0x48B6C00
    iForm75         // offset 0x48C5800
    iForm76         // offset 0x4910A00
    iUserbutton219  // offset 0x495BC00
    iUserbutton220  // offset 0x4979400
    iForm77         // offset 0x4996C00
    iUserbutton44   // offset 0x49E1E00
    iUserbutton221  // offset 0x49FF600
    iForm78         // offset 0x4A1CE00
    iUserbutton222  // offset 0x4A68000
    iUserbutton223  // offset 0x4A76C00
    iForm80         // offset 0x4A85800
    iUserbutton233  // offset 0x4AD0A00
    iUserbutton243  // offset 0x4AEE400
    i4Dbutton52     // offset 0x4B0BC00
    i4Dbutton67     // offset 0x4B10200
    iUserbutton4    // offset 0x4B14800
    iUserbutton48   // offset 0x4B32000
    iForm81         // offset 0x4B4FA00
    iUserbutton234  // offset 0x4B9AC00
    iUserbutton110  // offset 0x4B9F600
    iSmartSlider0   // offset 0x4BA8800
    iForm79         // offset 0x5896000
    iUserbutton229  // offset 0x58E1200
    iCustomdigits0  // offset 0x58E4A00
    iiCustomdigits0 // offset 0x58E5200
    iUserbutton227  // offset 0x58E6C00
    iUserbutton228  // offset 0x58EA400
    iUserbutton226  // offset 0x58EDC00
    iUserbutton166  // offset 0x58F1400
    iUserbutton170  // offset 0x58F4C00
    iCustomdigits1  // offset 0x58F8400
    iiCustomdigits1 // offset 0x58F8C00
    iCustomdigits2  // offset 0x58FA600
    iiCustomdigits2 // offset 0x58FAE00
    iCustomdigits70 // offset 0x58FC800
    iiCustomdigits70 // offset 0x58FD000
    iCustomdigits71 // offset 0x58FEA00
    iiCustomdigits71 // offset 0x58FF200
    iUserbutton246  // offset 0x5900C00
    iUserbutton247  // offset 0x5904400
    iUserbutton248  // offset 0x5907C00
    iUserbutton249  // offset 0x590B400
    iUserbutton250  // offset 0x590EC00
    iUserbutton251  // offset 0x5912400
    iCustomdigits72 // offset 0x5915C00
    iiCustomdigits72 // offset 0x5916400
    i4Dbutton66     // offset 0x5917E00
    iForm53         // offset 0x591C800
    iUserbutton163  // offset 0x5967A00
    iUserbutton164  // offset 0x596F400
    iUserbutton165  // offset 0x5976C00
    iUserbutton167  // offset 0x597E400
    iUserbutton168  // offset 0x5985E00
    iUserbutton169  // offset 0x598D600
    iCustomdigits3  // offset 0x5994E00
    iiCustomdigits3 // offset 0x5995600
    iCustomdigits4  // offset 0x5997000
    iiCustomdigits4 // offset 0x5997800
    iCustomdigits5  // offset 0x5999200
    iiCustomdigits5 // offset 0x5999A00
    i4Dbutton62     // offset 0x599B400
    iForm82         // offset 0x599FE00
    iUserbutton238  // offset 0x59EB000
    iUserbutton239  // offset 0x59FA000
    iUserimages25   // offset 0x5A09000
    iForm83         // offset 0x5A34A00
    iUserimages24   // offset 0x5A7FC00
    i4Dbutton89     // offset 0x5AAB600
    iForm84         // offset 0x5AC9000
    iUserbutton241  // offset 0x5B14200
    iUserbutton242  // offset 0x5B31A00
    iForm85         // offset 0x5B4F200
    iCustomdigits66 // offset 0x5B9A400
    iiCustomdigits66 // offset 0x5B9AE00
    iCustomdigits67 // offset 0x5B9C800
    iiCustomdigits67 // offset 0x5B9D200
    iCustomdigits68 // offset 0x5B9EC00
    iiCustomdigits68 // offset 0x5B9F600
    iCustomdigits69 // offset 0x5BA1000
    iiCustomdigits69 // offset 0x5BA1A00
    i4Dbutton54     // offset 0x5BA3400
    i4Dbutton69     // offset 0x5BA7E00
    iForm86         // offset 0x5BAC800
    iUserbutton252  // offset 0x5BF7A00
    iUserbutton253  // offset 0x5C33000
    iUserbutton254  // offset 0x5C6EA00
    iUserbutton124  // offset 0x5CA9C00
    iUserimages7    // offset 0x5CB2E00
    iForm87         // offset 0x5CD0800
    i4Dbutton74     // offset 0x5D1BA00
    i4Dbutton75     // offset 0x5D20400
    iUserbutton43   // offset 0x5D24E00
    iUserbutton47   // offset 0x5D60800
    iUserimages10   // offset 0x5D9BE00
    iUserbutton6    // offset 0x5DBA000
    iUserbutton21   // offset 0x5DD7800
    iForm88         // offset 0x5DF5000
    iForm89         // offset 0x5E40200
    iUserbutton28   // offset 0x5E8B400
    iUserbutton31   // offset 0x5EA8C00
    iForm91         // offset 0x5EC6400
    iUserbutton0    // offset 0x5F11600
    iUserbutton128  // offset 0x5F20200
    iForm92         // offset 0x5F2F200
    iUserbutton63   // offset 0x5F7A400
    iUserbutton72   // offset 0x5F97C00
    iForm93         // offset 0x5FA6E00
    iUserbutton62   // offset 0x5FF2000
    iUserbutton73   // offset 0x600F800
    iForm94         // offset 0x601EA00
    iUserbutton51   // offset 0x6069C00
    iUserbutton60   // offset 0x6087400
    iForm95         // offset 0x6096600
    iUserbutton89   // offset 0x60E1800
    iCustomdigits77 // offset 0x60FF200
    iiCustomdigits77 // offset 0x60FF600
    iCustomdigits78 // offset 0x6101000
    iiCustomdigits78 // offset 0x6101400
    iCustomdigits79 // offset 0x6102E00
    iiCustomdigits79 // offset 0x6103200
    iCustomdigits80 // offset 0x6104C00
    iiCustomdigits80 // offset 0x6105000
    iCustomdigits81 // offset 0x6106A00
    iiCustomdigits81 // offset 0x6106E00
    iCustomdigits82 // offset 0x6108800
    iiCustomdigits82 // offset 0x6108C00
    iCustomdigits83 // offset 0x610A600
    iiCustomdigits83 // offset 0x610AA00
    iCustomdigits84 // offset 0x610C400
    iiCustomdigits84 // offset 0x610C800
    iForm96         // offset 0x610E200
    i4Dbutton26     // offset 0x6159400
    i4Dbutton27     // offset 0x6168000
    iForm97         // offset 0x6176C00
    i4Dbutton40     // offset 0x61C1E00
    i4Dbutton41     // offset 0x61C6800
    iUserbutton99   // offset 0x61CB200
    iCustomdigits73 // offset 0x61F3800
    iiCustomdigits73 // offset 0x61F3C00
    iCustomdigits74 // offset 0x61F5600
    iiCustomdigits74 // offset 0x61F5A00
    iCustomdigits75 // offset 0x61F7400
    iiCustomdigits75 // offset 0x61F7800
    iCustomdigits76 // offset 0x61F9200
    iiCustomdigits76 // offset 0x61F9600
    iUserbutton100  // offset 0x61FB000
    iUserbutton101  // offset 0x620F200
    iUserbutton102  // offset 0x6222C00
    iUserimages17   // offset 0x6236800
    iForm98         // offset 0x623C000
    iUserbutton103  // offset 0x6287200
    iUserbutton104  // offset 0x62C2400
    iUserbutton105  // offset 0x62D6000
    iUserbutton106  // offset 0x62E9800
    iUserbutton107  // offset 0x62FD400
    iUserbutton108  // offset 0x6311000
    iUserbutton109  // offset 0x6324800
    iUserbutton120  // offset 0x6338400
    iUserimages8    // offset 0x6341600
    iUserimages9    // offset 0x635F000
    iForm99         // offset 0x6386000
    i4Dbutton97     // offset 0x63D1200
    iForm100        // offset 0x63EEC00
    i4Dbutton92     // offset 0x6439E00
    iForm101        // offset 0x6457800
    iUserbutton111  // offset 0x64A2A00
    iForm102        // offset 0x64C0C00
    iVideo12        // offset 0x650BE00
    iForm103        // offset 0x6B49E00
    iUserbutton125  // offset 0x6B95000
    iForm104        // offset 0x6BB2A00
    iForm27         // offset 0x6BFDC00
    i4Dbutton12     // offset 0x6C48E00
    i4Dbutton79     // offset 0x6C4D800
    iForm90         // offset 0x6C6B200
    i4Dbutton90     // offset 0x6CB6400
    iUserbutton69   // offset 0x6CD3E00
    iForm105        // offset 0x6CDD000
    i4Dbutton8      // offset 0x6D28200
    i4Dbutton94     // offset 0x6D2CC00
    iForm106        // offset 0x6D4A600
    i4Dbutton4      // offset 0x6D95800
    iForm48         // offset 0x6D9A200
    iUserbutton127  // offset 0x6DE5400
    iUserbutton210  // offset 0x6E02C00
    iForm107        // offset 0x6E11800
    i4Dbutton5      // offset 0x6E5CA00
    iVideo13        // offset 0x6E61400
    iVideo24        // offset 0x6F66600
    iVideo25        // offset 0x706B800
    iForm108        // offset 0x7170A00
    i4Dbutton9      // offset 0x71BBC00
    i4Dbutton95     // offset 0x71C0600
    iForm109        // offset 0x71DE000
    iUserbutton230  // offset 0x7229200
    i4Dbutton6      // offset 0x7246C00
    i4Dbutton7      // offset 0x724CA00
    i4Dbutton10     // offset 0x7252800
    iForm110        // offset 0x7257200
    i4Dbutton24     // offset 0x72A2400
    i4Dbutton25     // offset 0x72B1000
    iForm111        // offset 0x72BFC00
    iUserbutton235  // offset 0x730AE00
    iForm112        // offset 0x7345E00
    i4Dbutton96     // offset 0x7391000
    iForm40         // offset 0x73AEA00
    i4Dbutton17     // offset 0x73F9C00
    i4Dbutton81     // offset 0x73FE600
    iForm61         // offset 0x741C000
    i4Dbutton84     // offset 0x7467200
    iForm113        // offset 0x7484C00
    i4Dbutton18     // offset 0x74CFE00
    i4Dbutton19     // offset 0x74DEA00
    iForm114        // offset 0x74ED600
    i4Dbutton20     // offset 0x7538800
    i4Dbutton21     // offset 0x753D200
    iCustomdigits9  // offset 0x7541C00
    iiCustomdigits9 // offset 0x7542000
    iCustomdigits10 // offset 0x7543A00
    iiCustomdigits10 // offset 0x7543E00
    iCustomdigits19 // offset 0x7545800
    iiCustomdigits19 // offset 0x7545C00
    iCustomdigits22 // offset 0x7547600
    iiCustomdigits22 // offset 0x7547A00
    iForm115        // offset 0x7549400
    i4Dbutton22     // offset 0x7594600
    i4Dbutton23     // offset 0x7599000
    iCustomdigits31 // offset 0x759DA00
    iiCustomdigits31 // offset 0x759DE00
    iCustomdigits33 // offset 0x759F800
    iiCustomdigits33 // offset 0x759FC00
    iCustomdigits85 // offset 0x75A1600
    iiCustomdigits85 // offset 0x75A1A00
    iCustomdigits86 // offset 0x75A3400
    iiCustomdigits86 // offset 0x75A3800
    iUserbutton97   // offset 0x75A5200
    iUserbutton98   // offset 0x75C2C00
    iUserbutton231  // offset 0x75E0600
    iForm116        // offset 0x761C800
    iUserbutton10   // offset 0x7667A00
    iUserbutton20   // offset 0x7676600
    iForm117        // offset 0x7685200
    i4Dbutton46     // offset 0x76D0400
    iUserbutton36   // offset 0x76D4E00
    iForm118        // offset 0x76F2800
    i4Dbutton53     // offset 0x773DA00
    i4Dbutton33     // offset 0x7742400
    i4Dbutton28     // offset 0x7748200
    i4Dbutton29     // offset 0x774E000
    i4Dbutton30     // offset 0x7753E00
    i4Dbutton31     // offset 0x7759C00
    i4Dbutton32     // offset 0x775FA00
    i4Dbutton55     // offset 0x7765800
    i4Dbutton56     // offset 0x776B600
    i4Dbutton68     // offset 0x7771400
    i4Dbutton70     // offset 0x7777200
    iUserimages71   // offset 0x777D000
    iUserimages72   // offset 0x777E800
    iUserimages73   // offset 0x7780000
    iUserimages74   // offset 0x7781800
    iUserbutton52   // offset 0x7783000
    iUserbutton58   // offset 0x77BE200
    iForm119        // offset 0x77C6A00
    i4Dbutton98     // offset 0x7811C00
    iForm120        // offset 0x782F600
    i4Dbutton93     // offset 0x787A800
    iForm121        // offset 0x7898200
    iCustomdigits34 // offset 0x78E3400
    iiCustomdigits34 // offset 0x78E3800
    iCustomdigits35 // offset 0x78E5200
    iiCustomdigits35 // offset 0x78E5600
    iCustomdigits41 // offset 0x78E7000
    iiCustomdigits41 // offset 0x78E7400
    iCustomdigits42 // offset 0x78E8E00
    iiCustomdigits42 // offset 0x78E9200
    i4Dbutton99     // offset 0x78EAC00
    i4Dbutton100    // offset 0x78EF600
    iUserbutton71   // offset 0x78F4000
    iUserbutton96   // offset 0x7907A00
    iUserbutton119  // offset 0x791B600
    iUserbutton132  // offset 0x7943A00
#END

#constant  Strings15Size     0
#constant  Strings15StartH   0
#constant  Strings15StartL   0
#constant  Strings17Size     0
#constant  Strings17StartH   0
#constant  Strings17StartL   0
#constant  Strings18Size     0
#constant  Strings18StartH   0
#constant  Strings18StartL   0
#constant  Strings19Size     0
#constant  Strings19StartH   0
#constant  Strings19StartL   0
#constant  Strings20Size     0
#constant  Strings20StartH   0
#constant  Strings20StartL   0
#constant  Strings21Size     0
#constant  Strings21StartH   0
#constant  Strings21StartL   0
#constant  Strings22Size     0
#constant  Strings22StartH   0
#constant  Strings22StartL   0
#constant  Strings24Size     0
#constant  Strings24StartH   0
#constant  Strings24StartL   0
#constant  Strings25Size     0
#constant  Strings25StartH   0
#constant  Strings25StartL   0
#constant  Strings26Size     0
#constant  Strings26StartH   0
#constant  Strings26StartL   0
#constant  Strings28Size     0
#constant  Strings28StartH   0
#constant  Strings28StartL   0
#constant  Strings29Size     0
#constant  Strings29StartH   0
#constant  Strings29StartL   0
#constant  Strings30Size     0
#constant  Strings30StartH   0
#constant  Strings30StartL   0
#constant  Strings31Size     0
#constant  Strings31StartH   0
#constant  Strings31StartL   0
#constant  Strings32Size     0
#constant  Strings32StartH   0
#constant  Strings32StartL   0
#constant  Strings33Size     0
#constant  Strings33StartH   0
#constant  Strings33StartL   0
#constant  Strings34Size     0
#constant  Strings34StartH   0
#constant  Strings34StartL   0
#constant  Strings35Size     0
#constant  Strings35StartH   0
#constant  Strings35StartL   0
#constant  Strings36Size     0
#constant  Strings36StartH   0
#constant  Strings36StartL   0
#constant  Strings37Size     0
#constant  Strings37StartH   0
#constant  Strings37StartL   0
#constant  Strings40Size     0
#constant  Strings40StartH   0
#constant  Strings40StartL   0
#constant  Strings41Size     0
#constant  Strings41StartH   0
#constant  Strings41StartL   0
#constant  Strings42Size     0
#constant  Strings42StartH   0
#constant  Strings42StartL   0
#constant  Strings43Size     0
#constant  Strings43StartH   0
#constant  Strings43StartL   0
#constant  Strings45Size     0
#constant  Strings45StartH   0
#constant  Strings45StartL   0
#constant  Strings46Size     0
#constant  Strings46StartH   0
#constant  Strings46StartL   0
#constant  Strings47Size     0
#constant  Strings47StartH   0
#constant  Strings47StartL   0
#constant  Strings51Size     0
#constant  Strings51StartH   0
#constant  Strings51StartL   0
#constant  Strings54Size     0
#constant  Strings54StartH   0
#constant  Strings54StartL   0
#constant  Strings3StartH   0x0
#constant  Strings3StartL   0x0
#constant  Strings1StartH   0x0
#constant  Strings1StartL   0x200
#constant  Strings8StartH   0x0
#constant  Strings8StartL   0x400
#constant  Strings12StartH   0x0
#constant  Strings12StartL   0x600
#constant  Strings23StartH   0x0
#constant  Strings23StartL   0x800
#constant  Strings16StartH   0x0
#constant  Strings16StartL   0xA00
#constant  Strings2StartH   0x0
#constant  Strings2StartL   0xC00
#constant  Strings7StartH   0x0
#constant  Strings7StartL   0xE00
#constant  Strings9StartH   0x0
#constant  Strings9StartL   0x1000
#constant  Strings10StartH   0x0
#constant  Strings10StartL   0x1200
#constant  Strings27StartH   0x0
#constant  Strings27StartL   0x1400
#constant  Strings48StartH   0x0
#constant  Strings48StartL   0x1600
#constant  Strings13StartH   0x0
#constant  Strings13StartL   0x1800
#constant  Strings38StartH   0x0
#constant  Strings38StartL   0x1A00
#constant  Strings53StartH   0x0
#constant  Strings53StartL   0x1C00
#constant  Strings11StartH   0x0
#constant  Strings11StartL   0x1E00
#constant  Strings39StartH   0x0
#constant  Strings39StartL   0x2000
#constant  Strings44StartH   0x0
#constant  Strings44StartL   0x2200
#constant  Strings49StartH   0x0
#constant  Strings49StartL   0x2400
#constant  Strings52StartH   0x0
#constant  Strings52StartL   0x2600
#constant  Strings50StartH   0x0
#constant  Strings50StartL   0x2800
#constant  Strings55StartH   0x0
#constant  Strings55StartL   0x2A00
#constant  Strings5StartH   0x0
#constant  Strings5StartL   0x2C00
#constant  Strings6StartH   0x0
#constant  Strings6StartL   0x2E00
#constant  Strings0StartH   0x0
#constant  Strings0StartL   0x3000
#constant  Strings4StartH   0x0
#constant  Strings4StartL   0x3200
#constant  Strings14StartH   0x0
#constant  Strings14StartL   0x3400
#IFNOT EXISTS NOGLOBALS
var hndl ;
#ENDIF
