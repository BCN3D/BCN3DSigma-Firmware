// File generated 20/06/2017 12:05:07
// Warning! This is a generated file, any manual changes will be
// lost during the next generation.

#constant  Strings3Count    0
#constant  Strings3Size     1
#constant  Strings1Count    0
#constant  Strings1Size     1
#constant  Strings7Count    1
#constant  Strings7Size     37
#constant  Strings8Count    0
#constant  Strings8Size     1
#constant  Strings12Count    0
#constant  Strings12Size     1
#constant  Strings23Count    0
#constant  Strings23Size     1
#constant  Strings24Count    1
#constant  Strings24Size     19
#constant  Strings25Count    1
#constant  Strings25Size     37
#constant  Strings26Count    1
#constant  Strings26Size     37
#constant  Strings16Count    0
#constant  Strings16Size     1
#constant  Strings30Count    1
#constant  Strings30Size     37
#constant  Strings2Count    1
#constant  Strings2Size     4
#constant  Strings0Count    1
#constant  Strings0Size     4
#constant  Strings9Count    1
#constant  Strings9Size     4
#constant  Strings34Count    1
#constant  Strings34Size     4
#constant  Strings36Count    1
#constant  Strings36Size     4
#constant  Strings37Count    1
#constant  Strings37Size     4
#constant  Strings4Count    1
#constant  Strings4Size     4
#constant  Strings40Count    1
#constant  Strings40Size     16
#constant  Strings41Count    0
#constant  Strings41Size     1
#constant  Strings42Count    0
#constant  Strings42Size     1
#constant  Strings5Count    1
#constant  Strings5Size     7
#constant  Strings10Count    1
#constant  Strings10Size     7
#constant  Strings17Count    1
#constant  Strings17Size     7
#constant  Strings13Count    1
#constant  Strings13Size     7
#constant  Strings14Count    1
#constant  Strings14Size     7
#constant  Strings15Count    1
#constant  Strings15Size     7
#constant  Strings18Count    1
#constant  Strings18Size     7
#constant  Strings19Count    1
#constant  Strings19Size     9
#constant  Strings20Count    1
#constant  Strings20Size     9
#constant  Strings21Count    1
#constant  Strings21Size     9
#constant  Strings22Count    1
#constant  Strings22Size     9
#constant  Strings27Count    0
#constant  Strings27Size     1
#constant  Strings28Count    1
#constant  Strings28Size     22
#constant  Strings46Count    0
#constant  Strings46Size     1
#constant  Strings6Count    1
#constant  Strings6Size     4
#constant  Strings29Count    1
#constant  Strings29Size     4
#constant  Strings31Count    1
#constant  Strings31Size     4
#constant  Strings32Count    1
#constant  Strings32Size     4
#constant  Strings33Count    1
#constant  Strings33Size     4
#constant  Strings35Count    1
#constant  Strings35Size     4
#constant  Strings38Count    1
#constant  Strings38Size     4
#constant  Strings47Count    0
#constant  Strings47Size     1
#constant  Strings43Count    0
#constant  Strings43Size     1
#constant  Strings11Count    1
#constant  Strings11Size     7
#constant  Strings45Count    0
#constant  Strings45Size     1
#constant  Strings39Count    0
#constant  Strings39Size     1
#constant  Strings44Count    0
#constant  Strings44Size     1
#constant  Strings49Count    1
#constant  Strings49Size     12
#constant  Strings52Count    0
#constant  Strings52Size     1
#constant  Strings50Count    0
#constant  Strings50Size     1
#constant  Strings51Count    0
#constant  Strings51Size     1
// object indexes into ImageControl
#CONST
    iVideo0         // offset 0x0
    iForm1          // offset 0x56CC00
    iUserbutton1    // offset 0x5B7E00
    iUserbutton61   // offset 0x5CB800
    iUserbutton88   // offset 0x5DF200
    iForm2          // offset 0x5F2A00
    iUserbutton4    // offset 0x63DC00
    iUserbutton5    // offset 0x642200
    iUserbutton15   // offset 0x645A00
    iUserbutton37   // offset 0x66E400
    iUserbutton55   // offset 0x671C00
    iUserbutton14   // offset 0x67AE00
    iUserbutton56   // offset 0x6A3800
    iUserbutton85   // offset 0x6CC400
    iUserbutton86   // offset 0x6F5000
    iUserimages1    // offset 0x71DC00
    iVideo14        // offset 0x729E00
    iForm4          // offset 0x804E00
    iUserbutton6    // offset 0x850000
    iUserbutton7    // offset 0x855400
    iUserbutton8    // offset 0x87D200
    iUserbutton9    // offset 0x8A4A00
    iForm5          // offset 0x8CC800
    iUserbutton12   // offset 0x917A00
    iUserbutton13   // offset 0x93FC00
    iUserbutton54   // offset 0x967E00
    iUserbutton57   // offset 0x990000
    iForm6          // offset 0x994A00
    iUserbutton0    // offset 0x9DFC00
    iUserbutton2    // offset 0x9E4600
    iUserbutton50   // offset 0xA0C400
    iUserbutton159  // offset 0xA33C00
    iUserbutton89   // offset 0xA5BA00
    iForm9          // offset 0xA60400
    iUserbutton18   // offset 0xAAB600
    iUserbutton19   // offset 0xAD0200
    iUserbutton16   // offset 0xAE2800
    iForm14         // offset 0xAF4E00
    iUserbutton17   // offset 0xB40000
    iUserbutton32   // offset 0xB5DA00
    iUserbutton33   // offset 0xB7B200
    iForm19         // offset 0xB98C00
    iUserbutton52   // offset 0xBE3E00
    iForm20         // offset 0xC02000
    iUserbutton75   // offset 0xC4D200
    iUserbutton76   // offset 0xC88C00
    iUserbutton77   // offset 0xCC4200
    iUserbutton65   // offset 0xCCD400
    iUserbutton70   // offset 0xCEAE00
    iUserbutton78   // offset 0xD08800
    iUserbutton79   // offset 0xD26200
    iUserbutton126  // offset 0xD43C00
    iForm21         // offset 0xD4CE00
    iUserbutton53   // offset 0xD98000
    iVideo11        // offset 0xDB5800
    iForm27         // offset 0xF27E00
    iUserbutton21   // offset 0xF73000
    iUserbutton22   // offset 0xF78E00
    iUserbutton51   // offset 0xF7EC00
    iUserbutton72   // offset 0xF84A00
    iUserbutton96   // offset 0xF8A800
    iUserbutton97   // offset 0xF90600
    iUserbutton98   // offset 0xF96400
    iUserbutton99   // offset 0xF9C200
    iUserbutton100  // offset 0xFA2000
    iUserbutton101  // offset 0xFA7E00
    iUserbutton20   // offset 0xFADC00
    iForm28         // offset 0xFCB400
    iUserbutton11   // offset 0x1016600
    iUserbutton81   // offset 0x1034E00
    iUserbutton82   // offset 0x1053000
    iUserbutton83   // offset 0x1071800
    iVideo3         // offset 0x1076200
    iVideo4         // offset 0x1169000
    iVideo5         // offset 0x1256800
    iForm31         // offset 0x1346800
    iUserbutton94   // offset 0x1391A00
    iUserimages4    // offset 0x13AF200
    iForm32         // offset 0x1411C00
    iUserbutton95   // offset 0x145CE00
    iUserimages5    // offset 0x147A600
    iForm33         // offset 0x14DD000
    iUserbutton102  // offset 0x1528200
    iUserbutton103  // offset 0x152E000
    iUserbutton104  // offset 0x1533E00
    iUserbutton105  // offset 0x1539C00
    iUserbutton106  // offset 0x153FA00
    iUserbutton107  // offset 0x1545800
    iUserbutton108  // offset 0x154B600
    iUserbutton109  // offset 0x1551400
    iUserbutton110  // offset 0x1557200
    iUserbutton111  // offset 0x155D000
    iUserbutton26   // offset 0x1562E00
    iForm34         // offset 0x1580600
    iUserbutton112  // offset 0x15CB800
    iUserbutton113  // offset 0x15D2E00
    iUserbutton114  // offset 0x15DA400
    iVideo16        // offset 0x15F0E00
    iForm35         // offset 0x1750800
    iUserbutton115  // offset 0x179BA00
    iUserbutton116  // offset 0x17B2400
    iUserbutton117  // offset 0x17B9A00
    iVideo17        // offset 0x17C1000
    iForm16         // offset 0x1920A00
    iUserbutton41   // offset 0x196BC00
    iUserbutton158  // offset 0x197AE00
    iVideo10        // offset 0x198A000
    iForm44         // offset 0x1B17800
    iUserbutton151  // offset 0x1B62A00
    iUserbutton152  // offset 0x1B71A00
    iUserbutton154  // offset 0x1B80A00
    iUserbutton155  // offset 0x1BADC00
    iUserbutton156  // offset 0x1BDA800
    iUserbutton157  // offset 0x1BE9800
    iUserbutton160  // offset 0x1BF8800
    iUserbutton135  // offset 0x1BFD200
    iVideo20        // offset 0x1C06400
    iForm3          // offset 0x1CA5400
    iUserbutton27   // offset 0x1CF0600
    iUserbutton28   // offset 0x1CF6400
    iUserbutton29   // offset 0x1CFC200
    iForm13         // offset 0x1D19C00
    iUserbutton30   // offset 0x1D64E00
    iUserbutton31   // offset 0x1D82800
    iUserbutton35   // offset 0x1D88600
    iForm47         // offset 0x1D8E400
    iUserbutton58   // offset 0x1DD9600
    iForm17         // offset 0x1DF7800
    iVideo6         // offset 0x1E42A00
    iForm25         // offset 0x1F90E00
    iUserbutton43   // offset 0x1FDC000
    iUserbutton47   // offset 0x1FE1E00
    iUserbutton48   // offset 0x1FE7C00
    iUserbutton131  // offset 0x1FEDA00
    iUserbutton23   // offset 0x200B200
    iUserbutton24   // offset 0x2011000
    iForm48         // offset 0x2016E00
    iUserbutton60   // offset 0x2062000
    iUserbutton62   // offset 0x2067E00
    iUserbutton119  // offset 0x206DC00
    iUserbutton127  // offset 0x2073A00
    iUserbutton25   // offset 0x2091200
    iUserbutton73   // offset 0x2097000
    iForm49         // offset 0x209CE00
    iUserbutton128  // offset 0x20E8000
    iUserbutton129  // offset 0x20EDE00
    iUserbutton130  // offset 0x20F3C00
    iUserbutton64   // offset 0x2102800
    iForm52         // offset 0x2111400
    iUserbutton142  // offset 0x215C600
    iUserbutton143  // offset 0x2163C00
    iUserbutton144  // offset 0x216B600
    iUserbutton145  // offset 0x2172C00
    iUserbutton146  // offset 0x2177600
    iUserbutton147  // offset 0x217EC00
    iUserbutton148  // offset 0x2186600
    iUserbutton149  // offset 0x218DC00
    iUserbutton150  // offset 0x21AB600
    iUserbutton161  // offset 0x21B2C00
    iForm53         // offset 0x21BA200
    iUserbutton162  // offset 0x2205400
    iUserbutton163  // offset 0x2209E00
    iUserbutton164  // offset 0x2211800
    iUserbutton165  // offset 0x2219000
    iUserbutton166  // offset 0x2220800
    iUserbutton167  // offset 0x2228000
    iUserbutton168  // offset 0x222FA00
    iUserbutton169  // offset 0x2237200
    iUserbutton170  // offset 0x223EA00
    iForm10         // offset 0x2246200
    iUserbutton71   // offset 0x2291400
    iForm12         // offset 0x22AF600
    iUserbutton36   // offset 0x22FA800
    iForm15         // offset 0x2318A00
    iUserbutton38   // offset 0x2363C00
    iUserbutton39   // offset 0x2381400
    iForm8          // offset 0x239EC00
    iVideo1         // offset 0x23E9E00
    iForm11         // offset 0x247A800
    iUserbutton3    // offset 0x24C5A00
    iUserbutton40   // offset 0x24DBC00
    iUserbutton42   // offset 0x24E3600
    iUserbutton45   // offset 0x24EAE00
    iUserbutton46   // offset 0x24F2600
    iUserbutton44   // offset 0x24FA000
    iUserbutton34   // offset 0x24FEA00
    iVideo15        // offset 0x2503400
    iForm18         // offset 0x26C6E00
    iUserbutton59   // offset 0x2712000
    iUserbutton63   // offset 0x2739600
    iUserbutton80   // offset 0x273E000
    iUserbutton74   // offset 0x2765600
    iUserbutton216  // offset 0x276A000
    iForm36         // offset 0x2791600
    iVideo2         // offset 0x27DC800
    iForm29         // offset 0x2973000
    iUserbutton91   // offset 0x29BE200
    iUserbutton92   // offset 0x29F9C00
    iUserbutton120  // offset 0x2A35200
    iUserbutton121  // offset 0x2A39C00
    iUserbutton122  // offset 0x2A57600
    iUserimages0    // offset 0x2A74E00
    iUserbutton84   // offset 0x2A93000
    iForm22         // offset 0x2A97A00
    iUserbutton90   // offset 0x2AE2C00
    iUserbutton123  // offset 0x2B00A00
    iUserbutton124  // offset 0x2B1E600
    iUserbutton125  // offset 0x2B23000
    iForm37         // offset 0x2B2C200
    iUserbutton132  // offset 0x2B77400
    iForm38         // offset 0x2B95600
    iUserbutton133  // offset 0x2BE0800
    iForm39         // offset 0x2BFEA00
    iUserbutton138  // offset 0x2C49C00
    iUserbutton139  // offset 0x2C4E600
    iUserbutton140  // offset 0x2C53000
    iUserbutton141  // offset 0x2C7A800
    iUserbutton153  // offset 0x2CA2000
    iForm23         // offset 0x2CC9800
    iUserbutton66   // offset 0x2D14A00
    iVideo12        // offset 0x2D32200
    iForm42         // offset 0x2EA4800
    iUserbutton87   // offset 0x2EEFA00
    iUserbutton118  // offset 0x2F14600
    iUserbutton136  // offset 0x2F39200
    iUserbutton137  // offset 0x2F5DE00
    iForm43         // offset 0x2F67000
    iUserbutton68   // offset 0x2FB2200
    iForm46         // offset 0x2FD0400
    iUserbutton171  // offset 0x301B600
    iVideo9         // offset 0x3039800
    iForm50         // offset 0x31C7000
    iUserbutton177  // offset 0x3212200
    iUserbutton178  // offset 0x3218000
    iUserbutton179  // offset 0x321DE00
    iUserbutton180  // offset 0x322CA00
    iForm51         // offset 0x323B600
    iUserbutton181  // offset 0x3286800
    iUserbutton182  // offset 0x3295A00
    iForm54         // offset 0x32B3C00
    iUserbutton186  // offset 0x32FEE00
    iUserbutton187  // offset 0x330E000
    iForm55         // offset 0x332C200
    iUserbutton183  // offset 0x3377400
    iUserbutton184  // offset 0x3379800
    iUserbutton185  // offset 0x3388A00
    iForm41         // offset 0x33A6C00
    iUserbutton67   // offset 0x33F1E00
    iUserbutton188  // offset 0x3401000
    iForm24         // offset 0x341F200
    iUserbutton69   // offset 0x346A400
    iForm56         // offset 0x3488600
    iUserbutton189  // offset 0x34D3800
    iForm57         // offset 0x34F1A00
    iUserbutton49   // offset 0x353CC00
    iUserbutton190  // offset 0x355A400
    iForm7          // offset 0x3577C00
    iUserbutton192  // offset 0x35C2E00
    iForm58         // offset 0x35E1000
    iVideo19        // offset 0x362C200
    iForm60         // offset 0x36FBE00
    iUserbutton194  // offset 0x3747000
    iUserbutton195  // offset 0x3756200
    iForm61         // offset 0x3765400
    iVideo7         // offset 0x37B0600
    iForm62         // offset 0x393DE00
    iUserbutton191  // offset 0x3989000
    iVideo13        // offset 0x39A7200
    iForm63         // offset 0x3B19800
    iUserbutton10   // offset 0x3B64A00
    iForm59         // offset 0x3B82C00
    iUserbutton193  // offset 0x3BCDE00
    iUserbutton196  // offset 0x3BD2A00
    iUserbutton199  // offset 0x3BD7600
    iUserbutton200  // offset 0x3BE6400
    iUserbutton201  // offset 0x3BF5600
    iUserbutton202  // offset 0x3C04000
    iUserbutton203  // offset 0x3C13200
    iUserbutton204  // offset 0x3C29C00
    iUserbutton205  // offset 0x3C2E600
    iUserimages2    // offset 0x3C33000
    iForm64         // offset 0x3C47C00
    iUserbutton206  // offset 0x3C92E00
    iUserbutton207  // offset 0x3CB0600
    iForm40         // offset 0x3CCDE00
    iVideo8         // offset 0x3D19000
    iForm65         // offset 0x3EA6800
    iUserbutton197  // offset 0x3EF1A00
    iUserbutton198  // offset 0x3EF6400
    iUserbutton209  // offset 0x3F1DA00
    iUserbutton134  // offset 0x3F44A00
    iForm66         // offset 0x3F6C200
    iUserbutton210  // offset 0x3FB7400
    iUserbutton215  // offset 0x3FBBE00
    iForm67         // offset 0x3FC0800
    iUserbutton211  // offset 0x400BA00
    iVideo18        // offset 0x4029400
    iForm68         // offset 0x4241800
    iUserbutton212  // offset 0x428CA00
    iUserbutton213  // offset 0x4291400
    iForm26         // offset 0x4295E00
    iUserbutton93   // offset 0x42E1000
    iUserbutton172  // offset 0x42FE800
    iForm30         // offset 0x431C000
    iUserbutton173  // offset 0x4367200
    iUserbutton174  // offset 0x4375E00
    iForm45         // offset 0x4384A00
    iVideo21        // offset 0x43CFC00
    iForm69         // offset 0x4542200
    iForm70         // offset 0x458D400
    iUserbutton175  // offset 0x45D8600
    iForm71         // offset 0x45F6000
    iUserbutton176  // offset 0x4641200
    iForm72         // offset 0x465EC00
    iVideo22        // offset 0x46A9E00
    iForm73         // offset 0x481C400
    iVideo23        // offset 0x4867600
    iForm74         // offset 0x4EA5600
    iUserbutton208  // offset 0x4EF0800
    iUserbutton214  // offset 0x4EFF400
#END

#constant  Strings48Size     0
#constant  Strings48StartH   0
#constant  Strings48StartL   0
#constant  Strings3StartH   0x0
#constant  Strings3StartL   0x0
#constant  Strings1StartH   0x0
#constant  Strings1StartL   0x200
#constant  Strings7StartH   0x0
#constant  Strings7StartL   0x400
#constant  Strings8StartH   0x0
#constant  Strings8StartL   0x600
#constant  Strings12StartH   0x0
#constant  Strings12StartL   0x800
#constant  Strings23StartH   0x0
#constant  Strings23StartL   0xA00
#constant  Strings24StartH   0x0
#constant  Strings24StartL   0xC00
#constant  Strings25StartH   0x0
#constant  Strings25StartL   0xE00
#constant  Strings26StartH   0x0
#constant  Strings26StartL   0x1000
#constant  Strings16StartH   0x0
#constant  Strings16StartL   0x1200
#constant  Strings30StartH   0x0
#constant  Strings30StartL   0x1400
#constant  Strings2StartH   0x0
#constant  Strings2StartL   0x1600
#constant  Strings0StartH   0x0
#constant  Strings0StartL   0x1800
#constant  Strings9StartH   0x0
#constant  Strings9StartL   0x1A00
#constant  Strings34StartH   0x0
#constant  Strings34StartL   0x1C00
#constant  Strings36StartH   0x0
#constant  Strings36StartL   0x1E00
#constant  Strings37StartH   0x0
#constant  Strings37StartL   0x2000
#constant  Strings4StartH   0x0
#constant  Strings4StartL   0x2200
#constant  Strings40StartH   0x0
#constant  Strings40StartL   0x2400
#constant  Strings41StartH   0x0
#constant  Strings41StartL   0x2600
#constant  Strings42StartH   0x0
#constant  Strings42StartL   0x2800
#constant  Strings5StartH   0x0
#constant  Strings5StartL   0x2A00
#constant  Strings10StartH   0x0
#constant  Strings10StartL   0x2C00
#constant  Strings17StartH   0x0
#constant  Strings17StartL   0x2E00
#constant  Strings13StartH   0x0
#constant  Strings13StartL   0x3000
#constant  Strings14StartH   0x0
#constant  Strings14StartL   0x3200
#constant  Strings15StartH   0x0
#constant  Strings15StartL   0x3400
#constant  Strings18StartH   0x0
#constant  Strings18StartL   0x3600
#constant  Strings19StartH   0x0
#constant  Strings19StartL   0x3800
#constant  Strings20StartH   0x0
#constant  Strings20StartL   0x3A00
#constant  Strings21StartH   0x0
#constant  Strings21StartL   0x3C00
#constant  Strings22StartH   0x0
#constant  Strings22StartL   0x3E00
#constant  Strings27StartH   0x0
#constant  Strings27StartL   0x4000
#constant  Strings28StartH   0x0
#constant  Strings28StartL   0x4200
#constant  Strings46StartH   0x0
#constant  Strings46StartL   0x4400
#constant  Strings6StartH   0x0
#constant  Strings6StartL   0x4600
#constant  Strings29StartH   0x0
#constant  Strings29StartL   0x4800
#constant  Strings31StartH   0x0
#constant  Strings31StartL   0x4A00
#constant  Strings32StartH   0x0
#constant  Strings32StartL   0x4C00
#constant  Strings33StartH   0x0
#constant  Strings33StartL   0x4E00
#constant  Strings35StartH   0x0
#constant  Strings35StartL   0x5000
#constant  Strings38StartH   0x0
#constant  Strings38StartL   0x5200
#constant  Strings47StartH   0x0
#constant  Strings47StartL   0x5400
#constant  Strings43StartH   0x0
#constant  Strings43StartL   0x5600
#constant  Strings11StartH   0x0
#constant  Strings11StartL   0x5800
#constant  Strings45StartH   0x0
#constant  Strings45StartL   0x5A00
#constant  Strings39StartH   0x0
#constant  Strings39StartL   0x5C00
#constant  Strings44StartH   0x0
#constant  Strings44StartL   0x5E00
#constant  Strings49StartH   0x0
#constant  Strings49StartL   0x6000
#constant  Strings52StartH   0x0
#constant  Strings52StartL   0x6200
#constant  Strings50StartH   0x0
#constant  Strings50StartL   0x6400
#constant  Strings51StartH   0x0
#constant  Strings51StartL   0x6600
#IFNOT EXISTS NOGLOBALS
var hndl ;
#ENDIF
