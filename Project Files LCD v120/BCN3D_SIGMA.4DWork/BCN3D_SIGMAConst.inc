// File generated 16/09/2016 12:21:46
// Warning! This is a generated file, any manual changes will be
// lost during the next generation.

#constant  Strings3Count    0
#constant  Strings3Size     1
#constant  Strings1Count    0
#constant  Strings1Size     1
#constant  Strings7Count    1
#constant  Strings7Size     37
#constant  Strings8Count    0
#constant  Strings8Size     1
#constant  Strings12Count    0
#constant  Strings12Size     1
#constant  Strings23Count    0
#constant  Strings23Size     1
#constant  Strings24Count    1
#constant  Strings24Size     19
#constant  Strings25Count    1
#constant  Strings25Size     37
#constant  Strings26Count    1
#constant  Strings26Size     37
#constant  Strings16Count    0
#constant  Strings16Size     1
#constant  Strings30Count    1
#constant  Strings30Size     37
#constant  Strings2Count    1
#constant  Strings2Size     4
#constant  Strings0Count    1
#constant  Strings0Size     4
#constant  Strings9Count    1
#constant  Strings9Size     4
#constant  Strings34Count    1
#constant  Strings34Size     4
#constant  Strings36Count    1
#constant  Strings36Size     4
#constant  Strings37Count    1
#constant  Strings37Size     4
#constant  Strings4Count    1
#constant  Strings4Size     4
#constant  Strings40Count    1
#constant  Strings40Size     16
#constant  Strings41Count    0
#constant  Strings41Size     1
#constant  Strings42Count    0
#constant  Strings42Size     1
#constant  Strings5Count    1
#constant  Strings5Size     7
#constant  Strings10Count    1
#constant  Strings10Size     7
#constant  Strings17Count    1
#constant  Strings17Size     7
#constant  Strings13Count    1
#constant  Strings13Size     7
#constant  Strings14Count    1
#constant  Strings14Size     7
#constant  Strings15Count    1
#constant  Strings15Size     7
#constant  Strings18Count    1
#constant  Strings18Size     7
#constant  Strings19Count    1
#constant  Strings19Size     9
#constant  Strings20Count    1
#constant  Strings20Size     9
#constant  Strings21Count    1
#constant  Strings21Size     9
#constant  Strings22Count    1
#constant  Strings22Size     9
#constant  Strings27Count    0
#constant  Strings27Size     1
#constant  Strings28Count    1
#constant  Strings28Size     22
#constant  Strings46Count    0
#constant  Strings46Size     1
#constant  Strings6Count    1
#constant  Strings6Size     4
#constant  Strings29Count    1
#constant  Strings29Size     4
#constant  Strings31Count    1
#constant  Strings31Size     4
#constant  Strings32Count    1
#constant  Strings32Size     4
#constant  Strings33Count    1
#constant  Strings33Size     4
#constant  Strings35Count    1
#constant  Strings35Size     4
#constant  Strings38Count    1
#constant  Strings38Size     4
#constant  Strings47Count    0
#constant  Strings47Size     1
#constant  Strings43Count    0
#constant  Strings43Size     1
#constant  Strings11Count    1
#constant  Strings11Size     7
#constant  Strings45Count    0
#constant  Strings45Size     1
#constant  Strings48Count    0
#constant  Strings48Size     1
#constant  Strings39Count    0
#constant  Strings39Size     1
#constant  Strings44Count    0
#constant  Strings44Size     1
#constant  Strings49Count    1
#constant  Strings49Size     12
// object indexes into ImageControl
#CONST
    iVideo0         // offset 0x0
    iForm1          // offset 0x56CC00
    iUserbutton1    // offset 0x5B7E00
    iUserbutton61   // offset 0x5D5600
    iForm2          // offset 0x5F2E00
    iUserbutton4    // offset 0x63E000
    iUserbutton5    // offset 0x642600
    iUserbutton15   // offset 0x645E00
    iUserbutton37   // offset 0x66E800
    iUserbutton55   // offset 0x672000
    iUserbutton14   // offset 0x67B200
    iUserbutton56   // offset 0x6A3C00
    iUserbutton85   // offset 0x6CC800
    iUserbutton86   // offset 0x6F5400
    iUserimages1    // offset 0x71E000
    iVideo14        // offset 0x72A200
    iForm4          // offset 0x805200
    iUserbutton6    // offset 0x850400
    iUserbutton7    // offset 0x855800
    iUserbutton8    // offset 0x87D600
    iUserbutton9    // offset 0x8A4E00
    iForm5          // offset 0x8CCC00
    iUserbutton12   // offset 0x917E00
    iUserbutton13   // offset 0x940000
    iUserbutton54   // offset 0x968200
    iUserbutton57   // offset 0x990400
    iForm6          // offset 0x994E00
    iUserbutton0    // offset 0x9E0000
    iUserbutton2    // offset 0x9E4A00
    iUserbutton50   // offset 0xA0C800
    iUserbutton159  // offset 0xA34000
    iUserbutton89   // offset 0xA5BE00
    iForm9          // offset 0xA60800
    iUserbutton18   // offset 0xAABA00
    iUserbutton19   // offset 0xAD0600
    iUserbutton16   // offset 0xAE2C00
    iForm14         // offset 0xAF5200
    iUserbutton17   // offset 0xB40400
    iUserbutton32   // offset 0xB5DE00
    iUserbutton33   // offset 0xB6CA00
    iForm19         // offset 0xB7B800
    iUserbutton52   // offset 0xBC6A00
    iForm20         // offset 0xBE4C00
    iUserbutton75   // offset 0xC2FE00
    iUserbutton76   // offset 0xC6B800
    iUserbutton77   // offset 0xCA6E00
    iUserbutton65   // offset 0xCB0000
    iUserbutton70   // offset 0xCCDA00
    iUserbutton78   // offset 0xCEB400
    iUserbutton79   // offset 0xD08E00
    iUserbutton126  // offset 0xD26800
    iForm21         // offset 0xD2FA00
    iUserbutton53   // offset 0xD7AC00
    iVideo11        // offset 0xD98400
    iForm27         // offset 0xF0AA00
    iUserbutton21   // offset 0xF55C00
    iUserbutton22   // offset 0xF5BA00
    iUserbutton51   // offset 0xF61800
    iUserbutton72   // offset 0xF67600
    iUserbutton96   // offset 0xF6D400
    iUserbutton97   // offset 0xF73200
    iUserbutton98   // offset 0xF79000
    iUserbutton99   // offset 0xF7EE00
    iUserbutton100  // offset 0xF84C00
    iUserbutton101  // offset 0xF8AA00
    iUserbutton20   // offset 0xF90800
    iForm28         // offset 0xFAE000
    iUserbutton11   // offset 0xFF9200
    iUserbutton81   // offset 0x1017A00
    iUserbutton82   // offset 0x1035C00
    iUserbutton83   // offset 0x1054400
    iVideo3         // offset 0x1058E00
    iVideo4         // offset 0x114BC00
    iVideo5         // offset 0x1239400
    iForm31         // offset 0x1329400
    iUserbutton94   // offset 0x1374600
    iUserimages4    // offset 0x1391E00
    iForm32         // offset 0x13F4800
    iUserbutton95   // offset 0x143FA00
    iUserimages5    // offset 0x145D200
    iForm33         // offset 0x14BFC00
    iUserbutton102  // offset 0x150AE00
    iUserbutton103  // offset 0x1510C00
    iUserbutton104  // offset 0x1516A00
    iUserbutton105  // offset 0x151C800
    iUserbutton106  // offset 0x1522600
    iUserbutton107  // offset 0x1528400
    iUserbutton108  // offset 0x152E200
    iUserbutton109  // offset 0x1534000
    iUserbutton110  // offset 0x1539E00
    iUserbutton111  // offset 0x153FC00
    iUserbutton26   // offset 0x1545A00
    iForm34         // offset 0x1563200
    iUserbutton112  // offset 0x15AE400
    iUserbutton113  // offset 0x15B5A00
    iUserbutton114  // offset 0x15BD000
    iVideo16        // offset 0x15D3A00
    iForm35         // offset 0x1733400
    iUserbutton115  // offset 0x177E600
    iUserbutton116  // offset 0x1795000
    iUserbutton117  // offset 0x179C600
    iVideo17        // offset 0x17A3C00
    iForm16         // offset 0x1903600
    iUserbutton41   // offset 0x194E800
    iUserbutton158  // offset 0x195DA00
    iVideo10        // offset 0x196CC00
    iForm44         // offset 0x1AFA400
    iUserbutton151  // offset 0x1B45600
    iUserbutton152  // offset 0x1B54600
    iUserbutton154  // offset 0x1B63600
    iUserbutton155  // offset 0x1B90800
    iUserbutton156  // offset 0x1BBD400
    iUserbutton157  // offset 0x1BCC400
    iUserbutton160  // offset 0x1BDB400
    iUserbutton135  // offset 0x1BDFE00
    iVideo20        // offset 0x1BE9000
    iForm3          // offset 0x1C88000
    iUserbutton27   // offset 0x1CD3200
    iUserbutton28   // offset 0x1CD9000
    iUserbutton29   // offset 0x1CDEE00
    iForm13         // offset 0x1CFC800
    iUserbutton30   // offset 0x1D47A00
    iUserbutton31   // offset 0x1D65400
    iUserbutton35   // offset 0x1D6B200
    iForm47         // offset 0x1D71000
    iUserbutton58   // offset 0x1DBC200
    iForm17         // offset 0x1DDA400
    iVideo6         // offset 0x1E25600
    iForm25         // offset 0x1F73A00
    iUserbutton43   // offset 0x1FBEC00
    iUserbutton47   // offset 0x1FC4A00
    iUserbutton48   // offset 0x1FCA800
    iUserbutton131  // offset 0x1FD0600
    iUserbutton23   // offset 0x1FEDE00
    iUserbutton24   // offset 0x1FF3C00
    iForm48         // offset 0x1FF9A00
    iUserbutton60   // offset 0x2044C00
    iUserbutton62   // offset 0x204AA00
    iUserbutton119  // offset 0x2050800
    iUserbutton127  // offset 0x2056600
    iUserbutton25   // offset 0x2073E00
    iUserbutton73   // offset 0x2079C00
    iForm49         // offset 0x207FA00
    iUserbutton128  // offset 0x20CAC00
    iUserbutton129  // offset 0x20D0A00
    iUserbutton130  // offset 0x20D6800
    iUserbutton64   // offset 0x20E5400
    iForm52         // offset 0x20F4000
    iUserbutton142  // offset 0x213F200
    iUserbutton143  // offset 0x2146800
    iUserbutton144  // offset 0x214E200
    iUserbutton145  // offset 0x2155800
    iUserbutton146  // offset 0x215A200
    iUserbutton147  // offset 0x2161800
    iUserbutton148  // offset 0x2169200
    iUserbutton149  // offset 0x2170800
    iUserbutton150  // offset 0x218E200
    iUserbutton161  // offset 0x2195800
    iUserbutton134  // offset 0x219CE00
    iForm53         // offset 0x21A6000
    iUserbutton162  // offset 0x21F1200
    iUserbutton163  // offset 0x21F5C00
    iUserbutton164  // offset 0x21FD600
    iUserbutton165  // offset 0x2204E00
    iUserbutton166  // offset 0x220C600
    iUserbutton167  // offset 0x2213E00
    iUserbutton168  // offset 0x221B800
    iUserbutton169  // offset 0x2223000
    iUserbutton170  // offset 0x222A800
    iForm10         // offset 0x2232000
    iUserbutton71   // offset 0x227D200
    iForm12         // offset 0x229B400
    iUserbutton36   // offset 0x22E6600
    iForm15         // offset 0x2304800
    iUserbutton38   // offset 0x234FA00
    iUserbutton39   // offset 0x236D200
    iForm8          // offset 0x238AA00
    iVideo1         // offset 0x23D5C00
    iForm11         // offset 0x2466600
    iUserbutton3    // offset 0x24B1800
    iUserbutton40   // offset 0x24C7A00
    iUserbutton42   // offset 0x24CF400
    iUserbutton45   // offset 0x24D6C00
    iUserbutton46   // offset 0x24DE400
    iUserbutton44   // offset 0x24E5E00
    iUserbutton34   // offset 0x24EA800
    iVideo15        // offset 0x24EF200
    iForm18         // offset 0x26B2C00
    iUserbutton59   // offset 0x26FDE00
    iUserbutton63   // offset 0x2725400
    iUserbutton80   // offset 0x2729E00
    iUserbutton74   // offset 0x2751400
    iForm36         // offset 0x2755E00
    iVideo2         // offset 0x27A1000
    iForm29         // offset 0x2937800
    iUserbutton91   // offset 0x2982A00
    iUserbutton92   // offset 0x29BE400
    iUserbutton120  // offset 0x29F9A00
    iUserbutton121  // offset 0x29FE400
    iUserbutton122  // offset 0x2A1BE00
    iUserimages0    // offset 0x2A39600
    iUserbutton84   // offset 0x2A57800
    iForm22         // offset 0x2A5C200
    iUserbutton90   // offset 0x2AA7400
    iUserbutton123  // offset 0x2AC5200
    iUserbutton124  // offset 0x2AE2E00
    iUserbutton125  // offset 0x2AE7800
    iForm37         // offset 0x2AF0A00
    iUserbutton132  // offset 0x2B3BC00
    iForm38         // offset 0x2B59E00
    iUserbutton133  // offset 0x2BA5000
    iForm39         // offset 0x2BC3200
    iUserbutton138  // offset 0x2C0E400
    iUserbutton139  // offset 0x2C12E00
    iUserbutton140  // offset 0x2C17800
    iUserbutton141  // offset 0x2C3F000
    iUserbutton153  // offset 0x2C66800
    iForm23         // offset 0x2C8E000
    iUserbutton66   // offset 0x2CD9200
    iVideo12        // offset 0x2CF6A00
    iForm42         // offset 0x2E69000
    iUserbutton87   // offset 0x2EB4200
    iUserbutton118  // offset 0x2ED8E00
    iUserbutton136  // offset 0x2EFDA00
    iUserbutton137  // offset 0x2F22600
    iForm43         // offset 0x2F2B800
    iUserbutton68   // offset 0x2F76A00
    iForm46         // offset 0x2F94C00
    iUserbutton171  // offset 0x2FDFE00
    iVideo9         // offset 0x2FFE000
    iForm50         // offset 0x318B800
    iUserbutton177  // offset 0x31D6A00
    iUserbutton178  // offset 0x31DC800
    iUserbutton179  // offset 0x31E2600
    iUserbutton180  // offset 0x31F1200
    iForm51         // offset 0x31FFE00
    iUserbutton181  // offset 0x324B000
    iUserbutton182  // offset 0x325A200
    iForm54         // offset 0x3269400
    iUserbutton186  // offset 0x32B4600
    iUserbutton187  // offset 0x32C3800
    iForm55         // offset 0x32D2A00
    iUserbutton183  // offset 0x331DC00
    iUserbutton184  // offset 0x3320000
    iUserbutton185  // offset 0x332F200
    iForm41         // offset 0x333E400
    iUserbutton67   // offset 0x3389600
    iUserbutton188  // offset 0x3398800
    iForm24         // offset 0x33A7A00
    iUserbutton69   // offset 0x33F2C00
    iForm56         // offset 0x3410E00
    iUserbutton189  // offset 0x345C000
    iForm57         // offset 0x347A200
    iUserbutton49   // offset 0x34C5400
    iUserbutton190  // offset 0x34E2C00
    iForm7          // offset 0x3500400
    iUserbutton192  // offset 0x354B600
    iForm58         // offset 0x3569800
    iVideo19        // offset 0x35B4A00
    iForm60         // offset 0x3684600
    iUserbutton194  // offset 0x36CF800
    iUserbutton195  // offset 0x36DEA00
    iForm61         // offset 0x36EDC00
    iVideo7         // offset 0x3738E00
    iForm62         // offset 0x38C6600
    iUserbutton191  // offset 0x3911800
    iVideo13        // offset 0x392FA00
    iForm63         // offset 0x3AA2000
    iUserbutton10   // offset 0x3AED200
    iForm59         // offset 0x3B0B400
    iUserbutton193  // offset 0x3B56600
    iUserbutton196  // offset 0x3B5B200
    iUserbutton199  // offset 0x3B5FE00
    iUserbutton200  // offset 0x3B6EC00
    iUserbutton201  // offset 0x3B7DE00
    iUserbutton202  // offset 0x3B8C800
    iUserbutton203  // offset 0x3B9BA00
    iUserbutton204  // offset 0x3BB2400
    iUserbutton205  // offset 0x3BB6E00
    iUserimages2    // offset 0x3BBB800
    iForm64         // offset 0x3BD0400
    iUserbutton206  // offset 0x3C1B600
    iUserbutton207  // offset 0x3C38E00
    iForm40         // offset 0x3C56600
    iVideo8         // offset 0x3CA1800
    iForm65         // offset 0x3E2F000
    iUserbutton197  // offset 0x3E7A200
    iUserbutton198  // offset 0x3E7EC00
    iUserbutton209  // offset 0x3EA6200
    iForm66         // offset 0x3ECE000
    iUserbutton210  // offset 0x3F19200
    iUserbutton215  // offset 0x3F1DC00
    iForm67         // offset 0x3F22600
    iUserbutton211  // offset 0x3F6D800
    iVideo18        // offset 0x3F8B200
    iForm68         // offset 0x41A3600
    iUserbutton212  // offset 0x41EE800
    iUserbutton213  // offset 0x41F3200
#END

#constant  Strings3StartH   0x0
#constant  Strings3StartL   0x0
#constant  Strings1StartH   0x0
#constant  Strings1StartL   0x200
#constant  Strings7StartH   0x0
#constant  Strings7StartL   0x400
#constant  Strings8StartH   0x0
#constant  Strings8StartL   0x600
#constant  Strings12StartH   0x0
#constant  Strings12StartL   0x800
#constant  Strings23StartH   0x0
#constant  Strings23StartL   0xA00
#constant  Strings24StartH   0x0
#constant  Strings24StartL   0xC00
#constant  Strings25StartH   0x0
#constant  Strings25StartL   0xE00
#constant  Strings26StartH   0x0
#constant  Strings26StartL   0x1000
#constant  Strings16StartH   0x0
#constant  Strings16StartL   0x1200
#constant  Strings30StartH   0x0
#constant  Strings30StartL   0x1400
#constant  Strings2StartH   0x0
#constant  Strings2StartL   0x1600
#constant  Strings0StartH   0x0
#constant  Strings0StartL   0x1800
#constant  Strings9StartH   0x0
#constant  Strings9StartL   0x1A00
#constant  Strings34StartH   0x0
#constant  Strings34StartL   0x1C00
#constant  Strings36StartH   0x0
#constant  Strings36StartL   0x1E00
#constant  Strings37StartH   0x0
#constant  Strings37StartL   0x2000
#constant  Strings4StartH   0x0
#constant  Strings4StartL   0x2200
#constant  Strings40StartH   0x0
#constant  Strings40StartL   0x2400
#constant  Strings41StartH   0x0
#constant  Strings41StartL   0x2600
#constant  Strings42StartH   0x0
#constant  Strings42StartL   0x2800
#constant  Strings5StartH   0x0
#constant  Strings5StartL   0x2A00
#constant  Strings10StartH   0x0
#constant  Strings10StartL   0x2C00
#constant  Strings17StartH   0x0
#constant  Strings17StartL   0x2E00
#constant  Strings13StartH   0x0
#constant  Strings13StartL   0x3000
#constant  Strings14StartH   0x0
#constant  Strings14StartL   0x3200
#constant  Strings15StartH   0x0
#constant  Strings15StartL   0x3400
#constant  Strings18StartH   0x0
#constant  Strings18StartL   0x3600
#constant  Strings19StartH   0x0
#constant  Strings19StartL   0x3800
#constant  Strings20StartH   0x0
#constant  Strings20StartL   0x3A00
#constant  Strings21StartH   0x0
#constant  Strings21StartL   0x3C00
#constant  Strings22StartH   0x0
#constant  Strings22StartL   0x3E00
#constant  Strings27StartH   0x0
#constant  Strings27StartL   0x4000
#constant  Strings28StartH   0x0
#constant  Strings28StartL   0x4200
#constant  Strings46StartH   0x0
#constant  Strings46StartL   0x4400
#constant  Strings6StartH   0x0
#constant  Strings6StartL   0x4600
#constant  Strings29StartH   0x0
#constant  Strings29StartL   0x4800
#constant  Strings31StartH   0x0
#constant  Strings31StartL   0x4A00
#constant  Strings32StartH   0x0
#constant  Strings32StartL   0x4C00
#constant  Strings33StartH   0x0
#constant  Strings33StartL   0x4E00
#constant  Strings35StartH   0x0
#constant  Strings35StartL   0x5000
#constant  Strings38StartH   0x0
#constant  Strings38StartL   0x5200
#constant  Strings47StartH   0x0
#constant  Strings47StartL   0x5400
#constant  Strings43StartH   0x0
#constant  Strings43StartL   0x5600
#constant  Strings11StartH   0x0
#constant  Strings11StartL   0x5800
#constant  Strings45StartH   0x0
#constant  Strings45StartL   0x5A00
#constant  Strings48StartH   0x0
#constant  Strings48StartL   0x5C00
#constant  Strings39StartH   0x0
#constant  Strings39StartL   0x5E00
#constant  Strings44StartH   0x0
#constant  Strings44StartL   0x6000
#constant  Strings49StartH   0x0
#constant  Strings49StartL   0x6200
#IFNOT EXISTS NOGLOBALS
var hndl ;
#ENDIF
